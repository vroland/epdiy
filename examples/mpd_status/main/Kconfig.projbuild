## examples/mpd_status/main/Kconfig.projbuild
```kconfig
menu "Application Settings"

	menu "WiFi Connection Settings"

		config WIFI_SSID
			string "WiFi SSID"
			default "myssid"
			help
				SSID (network name) for the smart paper to connect to.

		config WIFI_PASSWORD
			string "WiFi Password"
			default "mypassword"
			help
				WiFi password (WPA2 or newer) for the smart paper to use.

	endmenu

endmenu
```

## software/firmware/components/epd_driver/Kconfig
```kconfig
menu "E-Paper Driver"
    choice EPD_DRIVER_DISPLAY_TYPE
        prompt "Display Type"
        default EPD_DISPLAY_TYPE_ED097OC4
        help
            This option sets the display type to drive.

        config EPD_DISPLAY_TYPE_ED097OC4
            bool "ED097OC4"

        config EPD_DISPLAY_TYPE_ED060SC4
            bool "ED060SC4"

        config EPD_DISPLAY_TYPE_ED097TC2
            bool "ED097TC2"
    endchoice
endmenu
```
